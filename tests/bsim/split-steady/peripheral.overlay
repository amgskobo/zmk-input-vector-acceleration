/*
 * Copyright (c) 2026 amgskobo
 * SPDX-License-Identifier: MIT
 *
 * A pointing device on the peripheral moving at one steady speed: (24, 18)
 * every 10 ms, 3000 counts/s by the processor's magnitude, from 4 s on.
 */

#include <zephyr/dt-bindings/input/input-event-codes.h>

#include "shared.dtsi"

&kscan {
    /delete-property/ exit-after;
    events = <>;
};

/ {
    mock_pointer: mock_pointer {
        compatible = "zmk,input-mock";
        status = "okay";
        event-startup-delay = <4000>;
        event-period = <10>;
        events
            = <INPUT_EV_REL INPUT_REL_X 24 0>
            , <INPUT_EV_REL INPUT_REL_Y 18 1>
            , <INPUT_EV_REL INPUT_REL_X 24 0>
            , <INPUT_EV_REL INPUT_REL_Y 18 1>
            , <INPUT_EV_REL INPUT_REL_X 24 0>
            , <INPUT_EV_REL INPUT_REL_Y 18 1>
            , <INPUT_EV_REL INPUT_REL_X 24 0>
            , <INPUT_EV_REL INPUT_REL_Y 18 1>
            , <INPUT_EV_REL INPUT_REL_X 24 0>
            , <INPUT_EV_REL INPUT_REL_Y 18 1>
            , <INPUT_EV_REL INPUT_REL_X 24 0>
            , <INPUT_EV_REL INPUT_REL_Y 18 1>
            , <INPUT_EV_REL INPUT_REL_X 24 0>
            , <INPUT_EV_REL INPUT_REL_Y 18 1>
            , <INPUT_EV_REL INPUT_REL_X 24 0>
            , <INPUT_EV_REL INPUT_REL_Y 18 1>
            , <INPUT_EV_REL INPUT_REL_X 24 0>
            , <INPUT_EV_REL INPUT_REL_Y 18 1>
            , <INPUT_EV_REL INPUT_REL_X 24 0>
            , <INPUT_EV_REL INPUT_REL_Y 18 1>
            , <INPUT_EV_REL INPUT_REL_X 24 0>
            , <INPUT_EV_REL INPUT_REL_Y 18 1>
            , <INPUT_EV_REL INPUT_REL_X 24 0>
            , <INPUT_EV_REL INPUT_REL_Y 18 1>
            , <INPUT_EV_REL INPUT_REL_X 24 0>
            , <INPUT_EV_REL INPUT_REL_Y 18 1>
            , <INPUT_EV_REL INPUT_REL_X 24 0>
            , <INPUT_EV_REL INPUT_REL_Y 18 1>
            , <INPUT_EV_REL INPUT_REL_X 24 0>
            , <INPUT_EV_REL INPUT_REL_Y 18 1>
            , <INPUT_EV_REL INPUT_REL_X 24 0>
            , <INPUT_EV_REL INPUT_REL_Y 18 1>
            , <INPUT_EV_REL INPUT_REL_X 24 0>
            , <INPUT_EV_REL INPUT_REL_Y 18 1>
            , <INPUT_EV_REL INPUT_REL_X 24 0>
            , <INPUT_EV_REL INPUT_REL_Y 18 1>
            , <INPUT_EV_REL INPUT_REL_X 24 0>
            , <INPUT_EV_REL INPUT_REL_Y 18 1>
            , <INPUT_EV_REL INPUT_REL_X 24 0>
            , <INPUT_EV_REL INPUT_REL_Y 18 1>
            , <INPUT_EV_REL INPUT_REL_X 24 0>
            , <INPUT_EV_REL INPUT_REL_Y 18 1>
            , <INPUT_EV_REL INPUT_REL_X 24 0>
            , <INPUT_EV_REL INPUT_REL_Y 18 1>
            , <INPUT_EV_REL INPUT_REL_X 24 0>
            , <INPUT_EV_REL INPUT_REL_Y 18 1>
            , <INPUT_EV_REL INPUT_REL_X 24 0>
            , <INPUT_EV_REL INPUT_REL_Y 18 1>
            , <INPUT_EV_REL INPUT_REL_X 24 0>
            , <INPUT_EV_REL INPUT_REL_Y 18 1>
            , <INPUT_EV_REL INPUT_REL_X 24 0>
            , <INPUT_EV_REL INPUT_REL_Y 18 1>
            , <INPUT_EV_REL INPUT_REL_X 24 0>
            , <INPUT_EV_REL INPUT_REL_Y 18 1>
            , <INPUT_EV_REL INPUT_REL_X 24 0>
            , <INPUT_EV_REL INPUT_REL_Y 18 1>
            , <INPUT_EV_REL INPUT_REL_X 24 0>
            , <INPUT_EV_REL INPUT_REL_Y 18 1>
            , <INPUT_EV_REL INPUT_REL_X 24 0>
            , <INPUT_EV_REL INPUT_REL_Y 18 1>
            , <INPUT_EV_REL INPUT_REL_X 24 0>
            , <INPUT_EV_REL INPUT_REL_Y 18 1>
            , <INPUT_EV_REL INPUT_REL_X 24 0>
            , <INPUT_EV_REL INPUT_REL_Y 18 1>
            , <INPUT_EV_REL INPUT_REL_X 24 0>
            , <INPUT_EV_REL INPUT_REL_Y 18 1>
            , <INPUT_EV_REL INPUT_REL_X 24 0>
            , <INPUT_EV_REL INPUT_REL_Y 18 1>
            , <INPUT_EV_REL INPUT_REL_X 24 0>
            , <INPUT_EV_REL INPUT_REL_Y 18 1>
            , <INPUT_EV_REL INPUT_REL_X 24 0>
            , <INPUT_EV_REL INPUT_REL_Y 18 1>
            , <INPUT_EV_REL INPUT_REL_X 24 0>
            , <INPUT_EV_REL INPUT_REL_Y 18 1>
            , <INPUT_EV_REL INPUT_REL_X 24 0>
            , <INPUT_EV_REL INPUT_REL_Y 18 1>
            , <INPUT_EV_REL INPUT_REL_X 24 0>
            , <INPUT_EV_REL INPUT_REL_Y 18 1>
            , <INPUT_EV_REL INPUT_REL_X 24 0>
            , <INPUT_EV_REL INPUT_REL_Y 18 1>
            ;
    };
};

&split_input {
    device = <&mock_pointer>;
};

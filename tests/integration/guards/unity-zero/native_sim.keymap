/*
 * Copyright (c) 2026 amgskobo
 * SPDX-License-Identifier: MIT
 */

#define TEST_MIN_FACTOR 500
#define TEST_MAX_FACTOR 3200
#define TEST_UNITY_SPEED 0
#define TEST_MAX_SPEED 6000
#include "../fixture.dtsi"

/*
 * Copyright (c) 2026 amgskobo
 * SPDX-License-Identifier: MIT
 */

/ {
    vector_accel: vector_accel {
        compatible = "zmk,input-processor-vector-acceleration";
        status = "okay";
        #input-processor-cells = <0>;
        track-remainders;
    };
};

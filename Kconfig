## dts/bindings/zmk,input-processor-vector-acceleration.yaml
```yaml
# SPDX-License-Identifier: MIT

description: Report-based fixed-point vector acceleration for relative pointer motion

compatible: "zmk,input-processor-vector-acceleration"

include: ip_zero_param.yaml

properties:
  min-factor:
    type: int
    default: 1000
    description: Gain at zero speed, in thousandths. Must be between 100 and 1000.

  max-factor:
    type: int
    default: 3500
    description: Gain at max-speed and above, in thousandths. Must be between 1000 and 20000.

  unity-speed:
    type: int
    default: 1000
    description: Vector speed in counts per second at which gain is exactly 1.0.

  max-speed:
    type: int
    default: 6000
    description: Vector speed in counts per second at which max-factor is reached.
```

## tests/integration/firmware/boards/shields/vector_accel_test/Kconfig.defconfig
```kconfig
if SHIELD_VECTOR_ACCEL_TEST

config ZMK_KEYBOARD_NAME
    default "Vector Test"

endif

if SHIELD_VECTOR_ACCEL_SPLIT_LEFT

config ZMK_KEYBOARD_NAME
    default "Vec Split"

config ZMK_SPLIT_ROLE_CENTRAL
    default y

endif

if SHIELD_VECTOR_ACCEL_SPLIT_LEFT || SHIELD_VECTOR_ACCEL_SPLIT_RIGHT

config ZMK_SPLIT
    default y

endif
```

## tests/integration/firmware/boards/shields/vector_accel_test/Kconfig.shield
```kconfig
# Copyright (c) 2026 amgskobo
# SPDX-License-Identifier: MIT

config SHIELD_VECTOR_ACCEL_TEST
    def_bool $(shields_list_contains,vector_accel_test)

config SHIELD_VECTOR_ACCEL_SPLIT_LEFT
    def_bool $(shields_list_contains,vector_accel_split_left)

config SHIELD_VECTOR_ACCEL_SPLIT_RIGHT
    def_bool $(shields_list_contains,vector_accel_split_right)
```

## tests/integration/module/Kconfig
```kconfig
config ZMK_INPUT_VECTOR_ACCELERATION_TEST_RUNTIME
    bool "Run vector acceleration runtime self-tests"
    depends on ZMK_INPUT_PROCESSOR_VECTOR_ACCELERATION

config ZMK_INPUT_VECTOR_ACCELERATION_TEST_PERSISTENCE
    bool "Run vector acceleration persistence self-tests"
    depends on ZMK_INPUT_PROCESSOR_VECTOR_ACCELERATION && SETTINGS_NVS

config ZMK_INPUT_VECTOR_ACCELERATION_TEST_STUDIO
    bool "Run vector acceleration custom-settings self-tests"
    depends on ZMK_INPUT_VECTOR_ACCELERATION_CUSTOM_SETTINGS
```
